## boards/shields/descipline_rf/Kconfig.defconfig
```kconfig
# Copyright (c) 2020 The ZMK Contributors
# SPDX-License-Identifier: MIT

if SHIELD_DESCIPLINE_RF

config ZMK_KEYBOARD_NAME
    default "descipline_rf"

endif
```

## boards/shields/descipline_rf/Kconfig.shield
```kconfig
# Copyright (c) 2020 The ZMK Contributors
# SPDX-License-Identifier: MIT

config SHIELD_DESCIPLINE_RF
    def_bool $(shields_list_contains,descipline_rf)
```
